## arch/arm/src/nrf51/Kconfig
```kconfig
#
# For a description of the syntax of this configuration file,
# see the file kconfig-language.txt in the NuttX tools repository.
#

comment "NRF51 Configuration Options"

choice
	prompt "NRF51 Chip Selection"
	default ARCH_CHIP_NRF51832
	depends on ARCH_CHIP_NRF51

config ARCH_CHIP_NRF51832
	bool "NRF51832"
	select ARCH_FAMILY_NRF51
	select ARCH_FAMILY_NRF51832
	#select NRF51_HAVE_I2C_MASTER
	#select NRF51_HAVE_UART

config ARCH_CHIP_NRF51840
	bool "NRF51840"
	select ARCH_FAMILY_NRF51
	select ARCH_FAMILY_NRF51840
	#select NRF51_HAVE_I2C_MASTER
	#select NRF51_HAVE_UART

endchoice # NRF51 Chip Selection

# NRF51 Families

config ARCH_FAMILY_NRF51
	bool
	default n

config ARCH_FAMILY_NRF51832
	bool
	default n

config ARCH_FAMILY_NRF51840
	bool
	default n

# Peripheral support

# Peripheral Selection

config NRF51_HAVE_I2C_MASTER
	bool
	default n

config NRF51_HAVE_SPI_MASTER
	bool
	default n

config NRF51_HAVE_UART
	bool
	default n

menu "NRF51 Peripheral Selection"

config NRF51_I2C0_MASTER
	bool "I2C0 Master"
	default n
	select NRF51_HAVE_I2C_MASTER

config NRF51_I2C1_MASTER
	bool "I2C1 Master"
	default n
	select NRF51_HAVE_I2C_MASTER

config NRF51_UART0
	bool "UART0"
	default n
	select UART0_SERIALDRIVER
	select NRF51_HAVE_UART

config NRF51_RNG
	bool "Random Generator"
	default n
	select ARCH_HAVE_RNG

config NRF51_QSPI
	bool "QSPI"
	default n
	depends on ARCH_CHIP_NRF51840

config NRF51_WDT
	bool "Watchdog (WDT)"
	default n
	select WATCHDOG

config NRF51_HAVE_UART
	bool
	default n

endmenu # NRF51 Peripheral Selection

config NRF51_FLASH_PREFETCH
	bool "Enable FLASH Pre-fetch"
	default y
	---help---
		Enable FLASH prefetch

config NRF51_PROGMEM
	bool "FLASH program memory"
	default n
	select ARCH_HAVE_PROGMEM
	---help---
		Enable support FLASH interfaces as defined in include/nuttx/progmem.h

config NRF51_UART0
	bool "UART0"
	default n
	select UART0_SERIALDRIVER
	select NRF51_HAVE_UART

menu "GPIO Interrupt Configuration"

config NRF51_GPIOIRQ
	bool "Support GPIO Interrupts"
	default n

endmenu # GPIO Interrupt Configuration
```

## boards/arm/nrf51/microbit/Kconfig
```kconfig
#
# For a description of the syntax of this configuration file,
# see the file kconfig-language.txt in the NuttX tools repository.
#

if ARCH_BOARD_MICROBIT

config NRF51_GENERIC_UART0_RX_PIN
	int "Pin select for UART0 TXD"
	default 23
	---help---
		Pin select for UART0 TXD

config NRF51_GENERIC_UART0_TX_PIN
	int "Pin select for UART0 TXD"
	default 24
	---help---
		Pin select for UART0 TXD

config NRF51_GENERIC_NUM_LEDS
	int "Number of LEDs"
	default 4
	---help---
		Number of LEDs

config NRF51_GENERIC_LED_ACTIVELOW
	bool "Board LEDs are 'active low'"
	default y
	---help---
		Board LEDs are 'active low'

# config NRF51_GENERIC_LED1_PIN
# 	int "Pin select for LED 1"
# 	default 17
# 	---help---
# 		Pin select for LED 1
# 
# config NRF51_GENERIC_LED2_PIN
# 	int "Pin select for LED 2"
# 	default 18
# 	---help---
# 		Pin select for LED 2
# 
# config NRF51_GENERIC_LED3_PIN
# 	int "Pin select for LED 3"
# 	default 19
# 	---help---
# 		Pin select for LED 3
# 
# config NRF51_GENERIC_LED4_PIN
# 	int "Pin select for LED 4"
# 	default 20
# 	---help---
# 		Pin select for LED 4

config NRF51_GENERIC_LED_ROW3_PIN
	int "Pin select for LED 4"
	default 15
	---help---
		Pin select for LED 4

config NRF51_GENERIC_LED_ROW2_PIN
	int "Pin select for LED 4"
	default 14
	---help---
		Pin select for LED 4

config NRF51_GENERIC_LED_ROW1_PIN
	int "Pin select for LED 4"
	default 13
	---help---
		Pin select for LED 4

config NRF51_GENERIC_LED_COL9_PIN
	int "Pin select for LED 4"
	default 12
	---help---
		Pin select for LED 4

config NRF51_GENERIC_LED_COL8_PIN
	int "Pin select for LED 4"
	default 11
	---help---
		Pin select for LED 4

config NRF51_GENERIC_LED_COL7_PIN
	int "Pin select for LED 4"
	default 10
	---help---
		Pin select for LED 4

config NRF51_GENERIC_LED_COL6_PIN
	int "Pin select for LED 4"
	default 9
	---help---
		Pin select for LED 4

config NRF51_GENERIC_LED_COL5_PIN
	int "Pin select for LED 4"
	default 8
	---help---
		Pin select for LED 4

config NRF51_GENERIC_LED_COL4_PIN
	int "Pin select for LED 4"
	default 7
	---help---
		Pin select for LED 4

config NRF51_GENERIC_LED_COL3_PIN
	int "Pin select for LED 4"
	default 6
	---help---
		Pin select for LED 4

config NRF51_GENERIC_LED_COL2_PIN
	int "Pin select for LED 4"
	default 5
	---help---
		Pin select for LED 4

config NRF51_GENERIC_LED_COL1_PIN
	int "Pin select for LED 4"
	default 4
	---help---
		Pin select for LED 4

config EXAMPLES_MICROBIT_LEDS_DEVPATH
	string
	default "/dev/userleds"
	---help---
		Pin select for LED 4
endif
```
